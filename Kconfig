## src/drivers/io_expander/Kconfig.expander
```kconfig
menu "IO Expander"
    menu "Enable used drivers in factory"
        config ESP_PANEL_DRIVERS_EXPANDER_USE_CH422G
            bool "Use CH422G"
            default y

        config ESP_PANEL_DRIVERS_EXPANDER_USE_HT8574
            bool "Use HT8574"
            default y

        config ESP_PANEL_DRIVERS_EXPANDER_USE_TCA95XX_8BIT
            bool "Use TCA95XX (8-bit)"
            default y

        config ESP_PANEL_DRIVERS_EXPANDER_USE_TCA95XX_16BIT
            bool "Use TCA95XX (16-bit)"
            default y
    endmenu
endmenu
```

## src/drivers/lcd/Kconfig.touch
```kconfig
menu "Driver - LCD"
    config ESP_PANEL_CONF_TOUCH_MAX_POINTS
        int "Max point number"
        default 5
        help
            Maximum number of touch points that can be handled by the touch driver.
            This value should be set to the maximum number of touch points supported by the touch controller.
endmenu
```
