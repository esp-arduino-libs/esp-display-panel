## Kconfig
```kconfig
menu "ESP Display Panel Configurations"
    config ESP_PANEL_CONF_FILE_SKIP
        bool "Unckeck this to use `esp_panel_conf.h`"
        default y
        help
            If want to use `esp_panel_conf.h` to configure the panel, uncheck this option. Otherwise, the configurations in sdkconfig will be used.

    config ESP_PANEL_BOARD_FILE_SKIP
        bool "Unckeck this to use `esp_panel_board_*.h`"
        default y
        help
            If want to use `esp_panel_board_*.h` to configure the panel, uncheck this option. Otherwise, the configurations in sdkconfig will be used.

    if ESP_PANEL_CONF_FILE_SKIP
        orsource "./src/panel/Kconfig.panel"
    endif

    if ESP_PANEL_BOARD_FILE_SKIP
        orsource "./src/board/Kconfig.board"
    endif

endmenu
```

## src/board/Kconfig.board
```kconfig
menu "Board"
    choice
        prompt "Select the default board type"
        default ESP_PANEL_IGNORE_BOARD

        config ESP_PANEL_IGNORE_BOARD
            bool "None"
            help
                Enable this option if not using a board.

        config ESP_PANEL_BOARD_DEFAULT_USE_SUPPORTED
            bool "Supported board"
            help
                Enable this option if using a supported board.

        config ESP_PANEL_BOARD_DEFAULT_USE_CUSTOM
            bool "Custom board"
            help
                Select this option if using a custom board.
    endchoice

    if ESP_PANEL_BOARD_DEFAULT_USE_SUPPORTED
        orsource "./Kconfig.board_supported"
    endif

    if ESP_PANEL_BOARD_DEFAULT_USE_CUSTOM
        orsource "./Kconfig.board_custom"
    endif

endmenu
```
